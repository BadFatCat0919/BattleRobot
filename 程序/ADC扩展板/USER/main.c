///////////////////////////////////////////////////////////////////-=505-Tech=-///
//CAUC拳皇-ADC扩展板
///////////////////////////////////////////////////////////////////-=505-Tech=-///
//版本：V1.0
//编写：徐天泽
//中国民航大学电子科技创新创业实践基地505创客实验室
///////////////////////////////////////////////////////////////////-=505-Tech=-///
//队名：CAUC拳皇
//队员：徐天泽 高兴源 陈相吕 盛  荔
///////////////////////////////////////////////////////////////////-=505-Tech=-///
//本程序仅供学习参考，未经许可，不得用于其它任何用途
///////////////////////////////////////////////////////////////////-=505-Tech=-///
#include "sys.h"
#include "delay.h"
#include "usart.h"
#include "adc.h"
#include "led.h"
///////////////////////////////////////////////////////////////////-=505-Tech=-///
extern U16_TO_U8_DATA ADC_BUFF[10];
///////////////////////////////////////////////////////////////////-=505-Tech=-///
void JTAGDisable(void);
/********************************************************************************
  功能：	主函数
  参数：	无
  返回：	无
  备注：	无
*********************************************************************************/
int main()
{
	uint8_t i;
	
  delay_init();        //延时初始化，函数内部初始化了时钟
  JTAGDisable();       //禁用JTAG
	
	LED_Init();
  uart_init(115200);   //串口1初始化
	ADC1_DMA_Init();     //ADC初始化
	
  while(1)
  {
		/*帧头*/
		while((USART1->SR&0X40)==0);
		USART_SendData(USART1,0xfe);
		while((USART1->SR&0X40)==0);
		USART_SendData(USART1,0xfd);
		for(i=0;i<10;i++)
		{
			while((USART1->SR&0X40)==0);
			USART_SendData(USART1,ADC_BUFF[i].u8[0]);
			while((USART1->SR&0X40)==0);
			USART_SendData(USART1,ADC_BUFF[i].u8[1]);
		}
		
		LED_User_Flash(20);
  }
}
/********************************************************************************
  功能：	禁用JTAG
  参数：	无
  返回：	无
  备注：	禁用JTAG调试，释放PA15、PB3、PB4
*********************************************************************************/
void JTAGDisable()
{
  RCC_APB2PeriphClockCmd(RCC_APB2Periph_AFIO, ENABLE);
  GPIO_PinRemapConfig(GPIO_Remap_SWJ_JTAGDisable, ENABLE);
}
/********************************************************************************
  功能：	保佑代码无BUG
  参数：	无
  返回：	无
  备注：	心诚则灵
*********************************************************************************/
//                                    _ooOoo_	
//                                   o8888888o
//                                   88" . "88
//                                   (| -_- |)
//                                   O\  =  /O
//                                ____/`---'\____
//                              .'  \\|     |//  `.
//                             /  \\|||  :  |||//  \
//                            /  _||||| -:- |||||-  \
//                            |   | \\\  -  /// |   |
//                            | \_|  ''\---/''  |   |
//                            \  .-\__  `-`  ___/-. /
//                      =======|. .'  /--.--\  `. .|=======
//                     ==."" '<  `.___\_<|>_/___.'  >'"".===
//                    ==| | :  ` - `.;`\ _ /`;.`/ - ` : | |==
//                   ===\  \ `-.   \_ __\ /__ _/   .-` /  /===
//                  =====`-.____`-.___\_____/___.-`____.-'=====
//                 ===================`=---='===================
//                ===============================================
///////////////////////////////////////////////////////////////////-=505-Tech=-///
