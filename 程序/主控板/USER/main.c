///////////////////////////////////////////////////////////////////-=505-Tech=-///
//CAUC拳皇
///////////////////////////////////////////////////////////////////-=505-Tech=-///
//编写：徐天泽
//中国民航大学电子科技创新创业实践基地505创客实验室
///////////////////////////////////////////////////////////////////-=505-Tech=-///
//本程序仅供学习参考，未经许可，不得用于其它任何用途
///////////////////////////////////////////////////////////////////-=505-Tech=-///
#include "main.h"
#include "menu.h"
#include "modes.h"
///////////////////////////////////////////////////////////////////-=505-Tech=-///
extern MENU_PAGE Homepage;
uint16_t TestFan=50;

extern uint8_t target;
///////////////////////////////////////////////////////////////////-=505-Tech=-///
void Program(void);
void JTAGDisable(void);
/********************************************************************************
  功能：	主函数
  参数：	无
  返回：	无
  备注：	存放各种初始化代码，显示菜单
*********************************************************************************/
int main()
{
	delay_init();										//延时初始化，函数内部初始化了时钟
	NVIC_PriorityGroupConfig(NVIC_PriorityGroup_2);		//2位抢占优先级，2位响应优先级
	JTAGDisable();										//禁用JTAG
	
	BLUETOOTH_Init();									//蓝牙初始化
	LED_Init();											//LED初始化
	KEY_Init();											//按键初始化
	BEEP_Init();                  						//蜂鸣器初始化
	USART3_ADCandUNO_Init(115200);						//串口2初始化
	UART4_Menu_Init(115200);							//串口4初始化
	ADC1_Init();										//ADC初始化
	PWM_Init();											//PWM输出初始化
	Encoder_Init();										//编码器初始化
	TIMInterrupt_Init();								//定时器中断初始化,控制算法集中在定时器中断中
	
	DATA_Load();
	if(Judge_Program_FirstRun())						//判断程序是否需要更新flash
	{
		DATA_Default();
		DATA_Save();
	}
  
	SOLGUI_Init(&Homepage);								//菜单初始化
	BEEP_Hint(2);
	while(1)
	{
		static uint8_t cursor=0;
		
		SOLGUI_Menu_PageStage();
		SOLGUI_Refresh();		

		switch(KEY_Scan())
		{
			case __KEY_L:
				cursor++;
				if(cursor>3)
					cursor=0;
				break;
			case __KEY_R:
				switch(cursor)
				{
					case 1:
						delay_ms(500);
						BEEP_Hint(1);
						MODE1();
						break;
					case 2:
						delay_ms(500);
						BEEP_Hint(2);
						MODE2();
						break;
					case 3:
						delay_ms(500);
						BEEP_Hint(3);
						MODE3();
						break;
				}
			break;
		}
		switch(cursor)
		{
			case 0:
				LED_RGB_ALLOFF();
				break;
			case 1:
				LED_ShowRed();
				break;
			case 2:
				LED_ShowGreen();
				break;
			case 3:
				LED_ShowBlue();
				break;
		}

		Program();					//主函数中除菜单显示外的其它代码
	}
}
/********************************************************************************
  功能：	主函数中除菜单显示外的其它代码
  参数：	无
  返回：	无
  备注：	过于冗长的代码会降低菜单显示速度，建议以其它方式实现，如将程序放到中断中
*********************************************************************************/
void Program()
{
	MotorL_P=0;
	MotorL_N=0;
	MotorR_P=0;
	MotorR_N=0;
	MotorJ_P=0;
	MotorJ_N=0;
}
/********************************************************************************
  功能：	禁用JTAG
  参数：	无
  返回：	无
  备注：	禁用JTAG调试，释放PA15、PB3、PB4
*********************************************************************************/
void JTAGDisable()
{
  RCC_APB2PeriphClockCmd(RCC_APB2Periph_AFIO, ENABLE);
  GPIO_PinRemapConfig(GPIO_Remap_SWJ_JTAGDisable, ENABLE);
}
/********************************************************************************
  功能：	保佑代码无BUG
  参数：	无
  返回：	无
  备注：	心诚则灵
*********************************************************************************/
//                                    _ooOoo_	
//                                   o8888888o
//                                   88" . "88
//                                   (| -_- |)
//                                   O\  =  /O
//                                ____/`---'\____
//                              .'  \\|     |//  `.
//                             /  \\|||  :  |||//  \
//                            /  _||||| -:- |||||-  \
//                            |   | \\\  -  /// |   |
//                            | \_|  ''\---/''  |   |
//                            \  .-\__  `-`  ___/-. /
//                      =======|. .'  /--.--\  `. .|=======
//                     ==."" '<  `.___\_<|>_/___.'  >'"".===
//                    ==| | :  ` - `.;`\ _ /`;.`/ - ` : | |==
//                   ===\  \ `-.   \_ __\ /__ _/   .-` /  /===
//                  =====`-.____`-.___\_____/___.-`____.-'=====
//                 ===================`=---='===================
//                ===============================================
///////////////////////////////////////////////////////////////////-=505-Tech=-///
